## Documentation/devicetree/bindings/display/panel/samsung,gtaxllte-boe-hx8279d.yaml
```yaml
# SPDX-License-Identifier: (GPL-2.0-only OR BSD-2-Clause)
%YAML 1.2
---
$id: http://devicetree.org/schemas/display/panel/samsung,gtaxllte-boe-hx8279d.yaml#
$schema: http://devicetree.org/meta-schemas/core.yaml#

title: Samsung Galaxy Tab A 10.1 (2016) LTE (SM-T585) HX8279-D DSI panel

maintainers:
  - Istvan Lovas <avataristvan@googlemail.com>

description:
  1200x1920 MIPI-DSI video mode panel of the Samsung Galaxy Tab A 10.1 (2016)
  LTE (SM-T585, gtaxllte), driven by a Himax HX8279-D. The panel ID reported
  by the bootloader is 0x827903, the "BOE2" variant of the downstream kernel.
  The vendor and model of the panel itself are unknown, hence the board based
  compatible. The brightness is set through a DSI register, there is no
  separate backlight device.

allOf:
  - $ref: panel-common.yaml#

properties:
  compatible:
    const: samsung,gtaxllte-boe-hx8279d

  reg:
    maxItems: 1

  iovcc-supply:
    description: I/O voltage supply (1.8 V)

  vdd-supply:
    description: Panel power supply (external buck, enabled by a GPIO)

required:
  - compatible
  - reg
  - reset-gpios
  - iovcc-supply
  - vdd-supply

unevaluatedProperties: false

examples:
  - |
    #include <dt-bindings/gpio/gpio.h>

    dsi {
        #address-cells = <1>;
        #size-cells = <0>;

        panel@0 {
            compatible = "samsung,gtaxllte-boe-hx8279d";
            reg = <0>;
            reset-gpios = <&gpd4 1 GPIO_ACTIVE_LOW>;
            iovcc-supply = <&vdd_ldo35>;
            vdd-supply = <&vdd_fixed_lcd>;
        };
    };

...
```

## Documentation/devicetree/bindings/power/supply/siliconmitus,sm5703-charger.yaml
```yaml
# SPDX-License-Identifier: (GPL-2.0 OR BSD-2-Clause)
%YAML 1.2
---
$id: http://devicetree.org/schemas/power/supply/siliconmitus,sm5703-charger.yaml#
$schema: http://devicetree.org/meta-schemas/core.yaml#

title: Silicon Mitus SM5703 PMIC Charger

maintainers:
  - Istvan Lovas <avataristvan@googlemail.com>

description:
  The charger block of the SM5703 PMIC. The cable type is read from the
  SM5703 MUIC, which sits on another I2C bus and is referenced by phandle;
  the battery temperature comes from an IIO channel (the battery NTC).

allOf:
  - $ref: power-supply.yaml#

properties:
  compatible:
    const: siliconmitus,sm5703-charger

  reg:
    maxItems: 1

  interrupts:
    maxItems: 1

  enable-gpios:
    maxItems: 1
    description: nCHG_EN pin of the charger

  siliconmitus,muic:
    $ref: /schemas/types.yaml#/definitions/phandle
    description: SM5703 MUIC node, read for the cable type

  io-channels:
    maxItems: 1
    description: battery temperature channel

  io-channel-names:
    const: batt-temp

required:
  - compatible
  - reg
  - enable-gpios
  - siliconmitus,muic
  - io-channels
  - io-channel-names

unevaluatedProperties: false

examples:
  - |
    #include <dt-bindings/gpio/gpio.h>

    i2c {
      #address-cells = <1>;
      #size-cells = <0>;

      charger@49 {
        compatible = "siliconmitus,sm5703-charger";
        reg = <0x49>;
        enable-gpios = <&gpd1 3 GPIO_ACTIVE_LOW>;
        siliconmitus,muic = <&muic>;
        io-channels = <&battery_ntc>;
        io-channel-names = "batt-temp";
      };
    };
```

## Documentation/devicetree/bindings/power/supply/siliconmitus,sm5703-fuel-gauge.yaml
```yaml
# SPDX-License-Identifier: (GPL-2.0 OR BSD-2-Clause)
%YAML 1.2
---
$id: http://devicetree.org/schemas/power/supply/siliconmitus,sm5703-fuel-gauge.yaml#
$schema: http://devicetree.org/meta-schemas/core.yaml#

title: Silicon Mitus SM5703 PMIC Fuel Gauge

maintainers:
  - Istvan Lovas <avataristvan@googlemail.com>

allOf:
  - $ref: power-supply.yaml#

properties:
  compatible:
    const: siliconmitus,sm5703-fuel-gauge

  reg:
    maxItems: 1

  interrupts:
    maxItems: 1

required:
  - compatible
  - reg

unevaluatedProperties: false

examples:
  - |
    i2c {
      #address-cells = <1>;
      #size-cells = <0>;

      fuel-gauge@71 {
        compatible = "siliconmitus,sm5703-fuel-gauge";
        reg = <0x71>;
      };
    };
```

## Documentation/devicetree/bindings/reset/samsung,exynos7870-dispaud-reset.yaml
```yaml
# SPDX-License-Identifier: (GPL-2.0-only OR BSD-2-Clause)
%YAML 1.2
---
$id: http://devicetree.org/schemas/reset/samsung,exynos7870-dispaud-reset.yaml#
$schema: http://devicetree.org/meta-schemas/core.yaml#

title: Samsung Exynos7870 DISPAUD block soft reset controller

maintainers:
  - Istvan Lovas <avataristvan@googlemail.com>

description:
  Soft reset register in the DISPAUD sysreg (DISPAUD_CFG). Each bit resets
  one audio block and is active high; bit 0 is the audio mixer, bit 1 the
  MI2S controller, bit 2 the AMP and bit 3 the audio DMA.

properties:
  compatible:
    const: samsung,exynos7870-dispaud-reset

  reg:
    maxItems: 1

  '#reset-cells':
    const: 1

required:
  - compatible
  - reg
  - '#reset-cells'

additionalProperties: false

examples:
  - |
    reset-controller@148f1000 {
        compatible = "samsung,exynos7870-dispaud-reset";
        reg = <0x148f1000 0x4>;
        #reset-cells = <1>;
    };
```

## Documentation/devicetree/bindings/sound/realtek,rt5659.yaml
```yaml
# SPDX-License-Identifier: (GPL-2.0-only OR BSD-2-Clause)
%YAML 1.2
---
$id: http://devicetree.org/schemas/sound/realtek,rt5659.yaml#
$schema: http://devicetree.org/meta-schemas/core.yaml#

title: RT5659/RT5658 audio CODEC

maintainers:
  - Animesh Agarwal <animeshagarwal28@gmail.com>

description: |
  This device supports I2C only.

  Pins on the device (for linking into audio routes) for RT5659/RT5658:
    * DMIC L1
    * DMIC R1
    * DMIC L2
    * DMIC R2
    * IN1P
    * IN1N
    * IN2P
    * IN2N
    * IN3P
    * IN3N
    * IN4P
    * IN4N
    * HPOL
    * HPOR
    * SPOL
    * SPOR
    * LOUTL
    * LOUTR
    * MONOOUT
    * PDML
    * PDMR
    * SPDIF

allOf:
  - $ref: dai-common.yaml#

properties:
  compatible:
    enum:
      - realtek,rt5659
      - realtek,rt5658

  reg:
    maxItems: 1

  interrupts:
    maxItems: 1

  clocks:
    maxItems: 1

  clock-names:
    const: mclk

  realtek,dmic1-data-pin:
    $ref: /schemas/types.yaml#/definitions/uint32
    enum:
      - 0 # dmic1 is not used
      - 1 # using IN2N pin as dmic1 data pin
      - 2 # using GPIO5 pin as dmic1 data pin
      - 3 # using GPIO9 pin as dmic1 data pin
      - 4 # using GPIO11 pin as dmic1 data pin
    description: Specify which pin to be used as DMIC1 data pin.
    default: 0

  realtek,dmic2-data-pin:
    $ref: /schemas/types.yaml#/definitions/uint32
    enum:
      - 0 # dmic2 is not used
      - 1 # using IN2P pin as dmic2 data pin
      - 2 # using GPIO6 pin as dmic2 data pin
      - 3 # using GPIO10 pin as dmic2 data pin
      - 4 # using GPIO12 pin as dmic2 data pin
    description: Specify which pin to be used as DMIC2 data pin.
    default: 0

  realtek,jd-src:
    $ref: /schemas/types.yaml#/definitions/uint32
    enum:
      - 0 # No JD is used
      - 1 # using JD3 as JD source
      - 2 # JD source for Intel HDA header
    description: Specify which JD source be used.
    default: 0

  realtek,in1-differential:
    type: boolean
    description: IN1 is a differential input.

  realtek,in3-differential:
    type: boolean
    description: IN3 is a differential input.

  realtek,in4-differential:
    type: boolean
    description: IN4 is a differential input.

  ldo1-en-gpios:
    maxItems: 1
    description: CODEC's LDO1_EN pin.

  reset-gpios:
    maxItems: 1
    description: CODEC's RESET pin.

  realtek,ldo1-en-gpios:
    maxItems: 1
    deprecated: true
    description: CODEC's LDO1_EN pin. Not read by the driver, use ldo1-en-gpios.

  realtek,reset-gpios:
    maxItems: 1
    deprecated: true
    description: CODEC's RESET pin. Not read by the driver, use reset-gpios.

  ports:
    $ref: /schemas/graph.yaml#/properties/ports

  port:
    $ref: audio-graph-port.yaml#
    unevaluatedProperties: false

required:
  - compatible
  - reg

unevaluatedProperties: false

examples:
  - |
    #include <dt-bindings/gpio/gpio.h>
    #include <dt-bindings/interrupt-controller/irq.h>

    i2c {
        #address-cells = <1>;
        #size-cells = <0>;

        codec@1b {
            compatible = "realtek,rt5659";
            reg = <0x1b>;
            interrupt-parent = <&gpio>;
            interrupts = <3 IRQ_TYPE_LEVEL_HIGH>;
            realtek,ldo1-en-gpios = <&gpio 3 GPIO_ACTIVE_HIGH>;
        };
    };
```

## Documentation/devicetree/bindings/sound/samsung,exynos7870-s1402x.yaml
```yaml
# SPDX-License-Identifier: (GPL-2.0-only OR BSD-2-Clause)
%YAML 1.2
---
$id: http://devicetree.org/schemas/sound/samsung,exynos7870-s1402x.yaml#
$schema: http://devicetree.org/meta-schemas/core.yaml#

title: Samsung Exynos7870 S1402X audio mixer

maintainers:
  - Istvan Lovas <avataristvan@googlemail.com>

description:
  Audio mixer in the Exynos7870 DISPAUD block. It sits between the I2S
  controller and the external codec pins and exposes one DAI for the
  application processor stream.

allOf:
  - $ref: dai-common.yaml#

properties:
  compatible:
    const: samsung,exynos7870-s1402x

  reg:
    maxItems: 1

  clocks:
    items:
      - description: APB bus clock
      - description: Mixer system clock

  clock-names:
    items:
      - const: apb
      - const: sysclk

  resets:
    maxItems: 1

  '#sound-dai-cells':
    const: 0

required:
  - compatible
  - reg
  - clocks
  - clock-names
  - resets
  - '#sound-dai-cells'

unevaluatedProperties: false

examples:
  - |
    #include <dt-bindings/clock/samsung,exynos7870-cmu.h>

    audio-mixer@14880000 {
        compatible = "samsung,exynos7870-s1402x";
        reg = <0x14880000 0x200>;
        clocks = <&cmu_dispaud CLK_GOUT_DISPAUD_APB_AUD>,
                 <&cmu_dispaud CLK_GOUT_DISPAUD_MIXER_AUD_SYSCLK>;
        clock-names = "apb", "sysclk";
        resets = <&dispaud_reset 0>;
        #sound-dai-cells = <0>;
    };
```

## Documentation/devicetree/bindings/sound/samsung,gtaxllte-audio.yaml
```yaml
# SPDX-License-Identifier: (GPL-2.0-only OR BSD-2-Clause)
%YAML 1.2
---
$id: http://devicetree.org/schemas/sound/samsung,gtaxllte-audio.yaml#
$schema: http://devicetree.org/meta-schemas/core.yaml#

title: Samsung Galaxy Tab A 10.1 LTE (SM-T585) audio complex with RT5659 codec

maintainers:
  - Istvan Lovas <avataristvan@googlemail.com>

allOf:
  - $ref: sound-card-common.yaml#

properties:
  compatible:
    const: samsung,gtaxllte-audio

  hp-det-gpios:
    maxItems: 1
    description: Combo jack insertion detect.

  cpu:
    type: object
    additionalProperties: false
    properties:
      sound-dai:
        maxItems: 1
        description: The I2S controller DAI.
    required:
      - sound-dai

  codec:
    type: object
    additionalProperties: false
    properties:
      sound-dai:
        items:
          - description: The S1402X audio mixer DAI.
          - description: The RT5659 codec DAI.
    required:
      - sound-dai

required:
  - compatible
  - model
  - cpu
  - codec

unevaluatedProperties: false

examples:
  - |
    #include <dt-bindings/gpio/gpio.h>

    sound {
        compatible = "samsung,gtaxllte-audio";
        model = "SM-T585";
        hp-det-gpios = <&gpa0 5 GPIO_ACTIVE_LOW>;
        audio-routing = "Headphone", "HPOL",
                        "Headphone", "HPOR";

        cpu {
            sound-dai = <&i2s0 0>;
        };

        codec {
            sound-dai = <&audio_mixer>, <&rt5659>;
        };
    };
```
